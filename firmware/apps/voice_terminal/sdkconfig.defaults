## firmware/components/native_runtime/Kconfig
```kconfig
menu "RVA native runtime"

config RVA_DIRECTOR_BOOTSTRAP_URL
    string "Director bootstrap URL"
    default ""
    help
        Provision the full http(s) URL ending in /v1/session/bootstrap.

config RVA_TENANT_ID
    string "Tenant identifier"
    default "default"

config RVA_DEVICE_BOOTSTRAP_TOKEN
    string "Director device bootstrap token"
    default ""
    help
        Keep empty in tracked sdkconfig.defaults; inject during provisioning.

config RVA_SNTP_SERVER
    string "SNTP server used for TLS and UDP grant expiry"
    default "pool.ntp.org"

config RVA_AUTO_START_CONVERSATION
    bool "Automatically open a voice session after provisioning"
    default y
    help
        When enabled the device opens and retries the voice session after
        Wi-Fi and Director provisioning are ready. This keeps the runtime
        lifecycle independent from touch input during bring-up and soak tests.

choice RVA_DEFAULT_MEDIA_PROFILE
    prompt "Default media profile for a new session"
    default RVA_DEFAULT_MEDIA_PROFILE_WSS
    help
        Selects the initial client preference for each new session. The server
        still makes the final selection from the advertised profile set, and
        the idle UI may select another profile for the following session.

config RVA_DEFAULT_MEDIA_PROFILE_WSS
    bool "WSS Opus 1"

config RVA_DEFAULT_MEDIA_PROFILE_UDP
    bool "UDP Opus GCM 1"

endchoice

config RVA_MIC_BUTTON_CONTROLS_SESSION
    bool "Allow MIC button to start or stop the voice session"
    default n
    depends on !RVA_AUTO_START_CONVERSATION
    help
        When disabled the MIC button is visual-only and will not publish
        start/stop lifecycle events. Settings and provisioning controls remain
        available. Re-enable after the transport and audio chain are stable.

config RVA_WIFI_PRIMARY_SSID
    string "Provisioned primary Wi-Fi SSID"
    default ""

config RVA_WIFI_PRIMARY_PASSWORD
    string "Provisioned primary Wi-Fi password"
    default ""

config RVA_WIFI_FALLBACK_SSID
    string "Provisioned fallback Wi-Fi SSID"
    default ""

config RVA_WIFI_FALLBACK_PASSWORD
    string "Provisioned fallback Wi-Fi password"
    default ""

config RVA_ENABLE_UI
    bool "Start the optional LVGL UI hook"
    default n

choice RVA_UPLINK_AFFINITY
    prompt "Lab-only uplink task affinity"
    default RVA_UPLINK_AFFINITY_UNPINNED
    help
        Selects only the task affinity variable used by EXP-RVA-001. Keep the
        unpinned default outside a resolved experiment; a production winner
        must be chosen from target measurements, not from this menu ordering.

config RVA_UPLINK_AFFINITY_UNPINNED
    bool "Bounded owners, no explicit affinity"

config RVA_UPLINK_AFFINITY_OPUS_CPU1
    bool "Opus on CPU1, sender on CPU0"

config RVA_UPLINK_AFFINITY_AUDIO_CPU1
    bool "Capture/framer/Opus on CPU1, sender on CPU0"

endchoice

endmenu
```

## firmware/reference/xiaozhi-overlay/sdkconfig.defaults
```kconfig
CONFIG_BOARD_TYPE_LICHUANG_DEV_S3=y
CONFIG_USE_AUDIO_PROCESSOR=y
CONFIG_USE_DEVICE_AEC=y
# CONFIG_USE_SERVER_AEC is not set
```
